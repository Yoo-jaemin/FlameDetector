/*
*******************************************************************************
* COPYRIGHT (c) 1992-2012 GASTRON Co.,Ltd. All rights reserved.
*******************************************************************************
* Model Name	: GTF-1100 Series
* Module name	: 
* Description	: 
* Version		: REV 0.51
* Start Date	: 2017.01.17
* Modify Date	: 2018.06.14
* C-Compiler	: avr-gcc
* MPU			: ATmega1281
* Written by	: Min-Sung, Kang (mskang@gastron.com)
*******************************************************************************
*/

/////////////////////////////////////////////////////////////////////////////////////////////////////////////////////////////////////

#include <stdio.h>
#include <string.h>
#include <stdlib.h>
#include <math.h>
#include <avr/interrupt.h>
#include <avr/pgmspace.h>

/////////////////////////////////////////////////////////////////////////////////////////////////////////////////////////////////////

#include "global.h"
#include "dbg_printf.h"

#include "ir.h"
#include "uv.h"
#include "uart1281.h"
#include "gpio.h"
#include "adc.h"
#include "mmi.h"
#include "eep.h"
#include "timer.h"

/////////////////////////////////////////////////////////////////////////////////////////////////////////////////////////////////////

U16		IrRaw[2][IR_WL_MAX][IR_BUF_SIZE];
U16		IrRawIndex;
U16		IrDetCnt, IrWarCnt;
U16		IrHiLmt, IrLoLmt, IrDebTime;
double	IrFlickerFactor, IrBitLmt, Ir1sAvrgDvOverLmt;

//non-hydrocarbon 추가
U16		IrSizeLmt_NHC, IrSizeLmtOnNonOperFlame, IrFreqSumLmt, IrDirCntSumLmt, IrTimeDvSumLmt, IrTimeDvSumLmtInCntZr;
U16		IrLoSizeLmtCpsRef_NHC, IrLoSizeLmt_NHC, IrSizeLmtInSizeDvPer;
U16		IrFreqAddCntLmt, IrDirCntLmtInTimeSame, IrTimeDvLmtInFreqSame_NHC;
double	IrSizeDvPerLmt, IrPtoPDvPerLmt;
//

U16		IrSizeLmt;
U8		IrTimeDvLmtInFreqSame;
double	Ir1sAvDvLmtInFreqSame;
U16		IrSizeDvLmtInFreqSame;
U16		IrLoSizeLmtCpsRef, IrFlickerCpsRefLmt;
U16		IrLoSizeLmt;
U8		IrNonDetCnt[IR_WL_MAX];
double	IrAvPtoPMax;
double	IrSpanBuf[IR_WL_MAX][IR_CAL_POINT_MAX], IrSpanVal[IR_WL_MAX][IR_CAL_POINT_MAX], IrSlope[IR_WL_MAX][IR_CAL_POINT_MAX];
U16		IrScale[IR_WL_MAX];
S8		IrRelRatioCorrVal_395,IrRelRatioCorrVal_530;
U16		IrSizeRocLmt;
U16		IrLoDriftChkTick[IR_WL_MAX], IrHiDriftChkTick[IR_WL_MAX];
U16		TripModeIrTimeDvLmt;

/////////////////////////////////////////////////////////////////////////////////////////////////////////////////////////////////////

const U8 IrLmtOffset_430[]PROGMEM = {
	0,		//0
	1,		//1
	1,		//2
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	35,		//40
};


const double IR_Rel_Ratio_Limit_395[]PROGMEM = {
	15.0,	// 0
	20.1,	// 1
	20.1,	// 2
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	99.8,	// 999
	99.8    // 1000	 

};
	
const double IR_Rel_Ratio_Limit_530[]PROGMEM = {
	10.0, // 0
	10.1, // 1
	10.1, // 2
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	99.8, // 999 
 	99.8  // 1000
}; 
	////////////////////////////////////////////////////////////////////////////////////////////////////////////////////////////////////

void Initialize_IR( void );
void IR_Calculation( U16 *pIrBuf, FLAME_HandleTypeDef *flame );
void IR_Detection( U8 index );
void IR_Slope_Calculator( U8 wl, U8 n );

/////////////////////////////////////////////////////////////////////////////////////////////////////////////////////////////////////

void Initialize_IR( void )
{
	IrRawIndex = 0;
	
	IrWarCnt = 0;
	IrDetCnt = 0;
	
	if( DeviceType == DTYPE_UVIR ){
		IrLoLmt = epr_sm[EEP_UVIR_IR_VOLT_LMT_L] * 0.001 / ADC_LSB;
		IrHiLmt = epr_sm[EEP_UVIR_IR_VOLT_LMT_H] * 0.001 / ADC_LSB;
		IrSizeLmt = epr_sm[EEP_UVIR_IR_SIZE_LMT];
		IrSizeLmt_NHC = epr_sm[EEP_UVIR_SIZE_LMT_NHC]; //non-hydrocarbon 추가
	}
	else {
		IrLoLmt = epr_sm[EEP_TRIP_IR_VOLT_LMT_L] * 0.001 / ADC_LSB;
		IrHiLmt = epr_sm[EEP_TRIP_IR_VOLT_LMT_H] * 0.001 / ADC_LSB;
		IrSizeLmt = epr_sm[EEP_TRIP_IR_SIZE_LMT];
	}
	
	IrDebTime = epr_sm[EEP_IR_PULSE_WIDTH_LMT];
	IrFlickerCpsRefLmt = epr_sm[EEP_IR_FLICKER_CPS_REF_LMT];
	IrFlickerFactor = ((double)epr_sm[EEP_IR_FLICKER_FACTOR] / 10000 );
	IrNonDetCnt[IR_WL_430] = 0xFF;
	IrNonDetCnt[IR_WL_395] = 0xFF;
	IrNonDetCnt[IR_WL_530] = 0xFF;
	
	IrTimeDvLmtInFreqSame = epr_sm[EEP_IR_TIME_DV_LMT_IN_FREQ_SAME];
	Ir1sAvDvLmtInFreqSame = ((double)epr_sm[EEP_IR_1SAV_DV_LMT_IN_FREQ_SAME] * 0.001 );
	IrSizeDvLmtInFreqSame = epr_sm[EEP_IR_SIZE_DV_LMT_IN_FREQ_SAME];
	
	IrLoSizeLmtCpsRef = epr_sm[EEP_IR_LOW_SIZE_LMT_CPS_REF];
	IrLoSizeLmt = epr_sm[EEP_IR_LOW_SIZE_LMT];
	
	//non-hydrocarbon 추가
	IrSizeLmtOnNonOperFlame = epr_sm[EEP_IR_SIZE_LMT_ON_NON_OPER_FLAME];
	IrLoSizeLmtCpsRef_NHC = epr_sm[EEP_IR_LOW_SIZE_LMT_CPS_REF_NHC];
	IrLoSizeLmt_NHC = epr_sm[EEP_IR_LOW_SIZE_LMT_NHC];
	IrFreqSumLmt = epr_sm[EEP_IR_FREQ_SUM_LMT];
	IrDirCntSumLmt = epr_sm[EEP_IR_DIR_CNT_SUM_LMT];
	IrTimeDvSumLmt = epr_sm[EEP_IR_TIME_DV_SUM_LMT];
	IrTimeDvSumLmtInCntZr = epr_sm[EEP_IR_TIME_DV_SUM_LMT_IN_CNT_ZERO];
	IrFreqAddCntLmt = epr_sm[EEP_IR_FREQ_ADD_CNT_LMT];
	IrDirCntLmtInTimeSame = epr_sm[EEP_IR_DIR_CNT_LMT_IN_TIME_SAME];
	IrSizeLmtInSizeDvPer = epr_sm[EEP_IR_SIZE_LMT_IN_IR_SIZE_DV_PER];
	IrSizeDvPerLmt = ((double)epr_sm[EEP_IR_SIZE_DV_PER_LMT] / 100);
	IrPtoPDvPerLmt = ((double)epr_sm[EEP_IR_PTOP_DV_PER_LMT] / 100);
	IrTimeDvLmtInFreqSame_NHC = epr_sm[EEP_IR_TIME_DV_LMT_IN_FREQ_SAME_NHC];
	//	
		
	Ir1sAvrgDvOverLmt = ((double)epr_sm[EEP_IR_1S_AVRG_DV_OVER_LMT] * 0.001 );
	
	IrBitLmt = ((double)epr_sm[EEP_IR_BIT_THRESHOLD_VOLT] * 0.001 );
	
	IrSizeRocLmt = epr_sm[EEP_IR_ROC_LMT];
	
	IrRelRatioCorrVal_395 = epr_sm[EEP_IR_REL_RATIO_LMT_CORR_VAL] >> 8 & 255;
	IrRelRatioCorrVal_530 = epr_sm[EEP_IR_REL_RATIO_LMT_CORR_VAL] & 255;

	TripModeIrTimeDvLmt = epr_sm[EEP_TRIPMODE_IR_TIME_DV_LMT];
	
	IrSpanBuf[IR_WL_430][0] = ((double)epr_sm[EEP_CAL_BUF_IR430_01] * 0.001);
	IrSpanBuf[IR_WL_430][1] = ((double)epr_sm[EEP_CAL_BUF_IR430_02] * 0.001);
	IrSpanBuf[IR_WL_430][2] = ((double)epr_sm[EEP_CAL_BUF_IR430_03] * 0.001);
	IrSpanBuf[IR_WL_430][3] = ((double)epr_sm[EEP_CAL_BUF_IR430_04] * 0.001);
	IrSpanBuf[IR_WL_430][4] = ((double)epr_sm[EEP_CAL_BUF_IR430_05] * 0.001);
	IrSpanBuf[IR_WL_430][5] = ((double)epr_sm[EEP_CAL_BUF_IR430_06] * 0.001);
	IrSpanBuf[IR_WL_430][6] = ((double)epr_sm[EEP_CAL_BUF_IR430_07] * 0.001);
	
	IrSpanBuf[IR_WL_395][0] = ((double)epr_sm[EEP_CAL_BUF_IR395_01] * 0.001);
	IrSpanBuf[IR_WL_395][1] = ((double)epr_sm[EEP_CAL_BUF_IR395_02] * 0.001);
	IrSpanBuf[IR_WL_395][2] = ((double)epr_sm[EEP_CAL_BUF_IR395_03] * 0.001);
	IrSpanBuf[IR_WL_395][3] = ((double)epr_sm[EEP_CAL_BUF_IR395_04] * 0.001);
	IrSpanBuf[IR_WL_395][4] = ((double)epr_sm[EEP_CAL_BUF_IR395_05] * 0.001);
	IrSpanBuf[IR_WL_395][5] = ((double)epr_sm[EEP_CAL_BUF_IR395_06] * 0.001);
	IrSpanBuf[IR_WL_395][6] = ((double)epr_sm[EEP_CAL_BUF_IR395_07] * 0.001);
	
	IrSpanBuf[IR_WL_530][0] = ((double)epr_sm[EEP_CAL_BUF_IR530_01] * 0.001);
	IrSpanBuf[IR_WL_530][1] = ((double)epr_sm[EEP_CAL_BUF_IR530_02] * 0.001);
	IrSpanBuf[IR_WL_530][2] = ((double)epr_sm[EEP_CAL_BUF_IR530_03] * 0.001);
	IrSpanBuf[IR_WL_530][3] = ((double)epr_sm[EEP_CAL_BUF_IR530_04] * 0.001);
	IrSpanBuf[IR_WL_530][4] = ((double)epr_sm[EEP_CAL_BUF_IR530_05] * 0.001);
	IrSpanBuf[IR_WL_530][5] = ((double)epr_sm[EEP_CAL_BUF_IR530_06] * 0.001);
	IrSpanBuf[IR_WL_530][6] = ((double)epr_sm[EEP_CAL_BUF_IR530_07] * 0.001);
	
	if( DeviceType == DTYPE_UVIR ){
		IrSpanVal[IR_WL_430][0] = epr_sm[EEP_CAL_VAL_IR430_01];
		IrSpanVal[IR_WL_430][1] = epr_sm[EEP_CAL_VAL_IR430_02];
		IrSpanVal[IR_WL_430][2] = epr_sm[EEP_CAL_VAL_IR430_03];
		IrSpanVal[IR_WL_430][3] = epr_sm[EEP_CAL_VAL_IR430_04];
		IrSpanVal[IR_WL_430][4] = epr_sm[EEP_CAL_VAL_IR430_05];
		IrSpanVal[IR_WL_430][5] = epr_sm[EEP_CAL_VAL_IR430_06];
		IrSpanVal[IR_WL_430][6] = epr_sm[EEP_CAL_VAL_IR430_07];
		/*if( FlameType == NON_HYDROCARBON ){
			IrSpanVal[IR_WL_430][0] = epr_sm[EEP_CAL_VAL_IR430_01];
			IrSpanVal[IR_WL_430][1] = epr_sm[EEP_CAL_VAL_IR430_02];
			IrSpanVal[IR_WL_430][2] = epr_sm[EEP_CAL_VAL_IR430_03];
			IrSpanVal[IR_WL_430][3] = epr_sm[EEP_CAL_VAL_IR430_04];
			IrSpanVal[IR_WL_430][4] = epr_sm[EEP_CAL_VAL_IR430_05];
			IrSpanVal[IR_WL_430][5] = epr_sm[EEP_CAL_VAL_IR430_06];
			IrSpanVal[IR_WL_430][6] = epr_sm[EEP_CAL_VAL_IR430_07];
		}
		else{
			IrSpanVal[IR_WL_430][0] = (double)pgm_read_word( &EEP_SYS_DEFAULT[EEP_CAL_VAL_IR430_01] );
			IrSpanVal[IR_WL_430][1] = (double)pgm_read_word( &EEP_SYS_DEFAULT[EEP_CAL_VAL_IR430_02] );
			IrSpanVal[IR_WL_430][2] = (double)pgm_read_word( &EEP_SYS_DEFAULT[EEP_CAL_VAL_IR430_03] );
			IrSpanVal[IR_WL_430][3] = (double)pgm_read_word( &EEP_SYS_DEFAULT[EEP_CAL_VAL_IR430_04] );
			IrSpanVal[IR_WL_430][4] = (double)pgm_read_word( &EEP_SYS_DEFAULT[EEP_CAL_VAL_IR430_05] );
			IrSpanVal[IR_WL_430][5] = (double)pgm_read_word( &EEP_SYS_DEFAULT[EEP_CAL_VAL_IR430_06] );
			IrSpanVal[IR_WL_430][6] = (double)pgm_read_word( &EEP_SYS_DEFAULT[EEP_CAL_VAL_IR430_07] );
		}*/
	}
	else {
		IrSpanVal[IR_WL_430][0] = epr_sm[EEP_CAL_VAL_IR430_01];
		IrSpanVal[IR_WL_430][1] = epr_sm[EEP_CAL_VAL_IR430_02];
		IrSpanVal[IR_WL_430][2] = epr_sm[EEP_CAL_VAL_IR430_03];
		IrSpanVal[IR_WL_430][3] = epr_sm[EEP_CAL_VAL_IR430_04];
		IrSpanVal[IR_WL_430][4] = epr_sm[EEP_CAL_VAL_IR430_05];
		IrSpanVal[IR_WL_430][5] = epr_sm[EEP_CAL_VAL_IR430_06];
		IrSpanVal[IR_WL_430][6] = epr_sm[EEP_CAL_VAL_IR430_07];
		
		IrSpanVal[IR_WL_395][0] = epr_sm[EEP_CAL_VAL_IR395_01];
		IrSpanVal[IR_WL_395][1] = epr_sm[EEP_CAL_VAL_IR395_02];
		IrSpanVal[IR_WL_395][2] = epr_sm[EEP_CAL_VAL_IR395_03];
		IrSpanVal[IR_WL_395][3] = epr_sm[EEP_CAL_VAL_IR395_04];
		IrSpanVal[IR_WL_395][4] = epr_sm[EEP_CAL_VAL_IR395_05];
		IrSpanVal[IR_WL_395][5] = epr_sm[EEP_CAL_VAL_IR395_06];
		IrSpanVal[IR_WL_395][6] = epr_sm[EEP_CAL_VAL_IR395_07];
		
		IrSpanVal[IR_WL_530][0] = epr_sm[EEP_CAL_VAL_IR530_01];
		IrSpanVal[IR_WL_530][1] = epr_sm[EEP_CAL_VAL_IR530_02];
		IrSpanVal[IR_WL_530][2] = epr_sm[EEP_CAL_VAL_IR530_03];
		IrSpanVal[IR_WL_530][3] = epr_sm[EEP_CAL_VAL_IR530_04];
		IrSpanVal[IR_WL_530][4] = epr_sm[EEP_CAL_VAL_IR530_05];
		IrSpanVal[IR_WL_530][5] = epr_sm[EEP_CAL_VAL_IR530_06];
		IrSpanVal[IR_WL_530][6] = epr_sm[EEP_CAL_VAL_IR530_07];
	}
	
	IR_Slope_Calculator( IR_WL_430, 0 );
	IR_Slope_Calculator( IR_WL_430, 1 );
	IR_Slope_Calculator( IR_WL_430, 2 );
	IR_Slope_Calculator( IR_WL_430, 3 );
	IR_Slope_Calculator( IR_WL_430, 4 );
	IR_Slope_Calculator( IR_WL_430, 5 );
	IR_Slope_Calculator( IR_WL_430, 6 );
	
	IR_Slope_Calculator( IR_WL_395, 0 );
	IR_Slope_Calculator( IR_WL_395, 1 );
	IR_Slope_Calculator( IR_WL_395, 2 );
	IR_Slope_Calculator( IR_WL_395, 3 );
	IR_Slope_Calculator( IR_WL_395, 4 );
	IR_Slope_Calculator( IR_WL_395, 5 );
	IR_Slope_Calculator( IR_WL_395, 6 );
	
	IR_Slope_Calculator( IR_WL_530, 0 );
	IR_Slope_Calculator( IR_WL_530, 1 );
	IR_Slope_Calculator( IR_WL_530, 2 );
	IR_Slope_Calculator( IR_WL_530, 3 );
	IR_Slope_Calculator( IR_WL_530, 4 );
	IR_Slope_Calculator( IR_WL_530, 5 );
	IR_Slope_Calculator( IR_WL_530, 6 );
	
	DPRINT( " [ IR ]\n" );
	DPRINT3( "\n NOISE: %.3f[V], %.3f[V], %u[MSEC]", (double)(IrLoLmt * ADC_LSB), (double)(IrHiLmt * ADC_LSB), IrDebTime*4 );
	DPRINT1( "\n BIT: %.3f[V]", IrBitLmt );
	DPRINT1( "\n SIZE: %2u", IrSizeLmt );
	
	if( DeviceType == DTYPE_UVIR ){
		DPRINT1( "\n FREQ SAME: %u[MSEC]", IrTimeDvLmtInFreqSame*4 );
		DPRINT2( "\n FLK: %u[CPS], %.6f", IrFlickerCpsRefLmt, IrFlickerFactor );
		DPRINT1( "\n 1S AVER DEV: %.3f[V]", Ir1sAvrgDvOverLmt );
		DPRINT2( "\n LO SIZE: %u[CPS], %u", IrLoSizeLmtCpsRef, IrLoSizeLmt );
		DPRINT1( "\n RESPONSIVITY: %u", epr_sm[EEP_CAL_BUF_IR430_RESPONSIVITY] );
	}
	else {
		DPRINT1( "\n R.R.RATIO COR 395: %d", IrRelRatioCorrVal_395 );
		DPRINT1( "\n R.R.RATIO COR 530: %d", IrRelRatioCorrVal_530 );
		DPRINT1( "\n SIZE ROC: %u", IrSizeRocLmt );
		DPRINT3( "\n FREQ SAME: %u[MSEC], %.3f[V], %u", IrTimeDvLmtInFreqSame*4, Ir1sAvDvLmtInFreqSame, IrSizeDvLmtInFreqSame );
		DPRINT1( "\n TD: %u", TripModeIrTimeDvLmt );
	}

	IrAvPtoPMax = 0;
}

/////////////////////////////////////////////////////////////////////////////////////////////////////////////////////////////////////

void IR_Calculation( U16 *pIrBuf, FLAME_HandleTypeDef *flame )
{
	FLAME_HandleTypeDef		*fp;
	double					fBuf;
	S16						FreqDv, TimeDv;
	U16						i, PulseWidth, IrBuf; //, iPeak;
	U8						Status;
	U16						wi, wc, LoCnt, HiCnt, wSize[3];
	double					min, max;
	//U16						LoPeakPrv, LoPeakCur, LoPeakDv, LoPeakDvSum;
	//U16						HiPeakPrv, HiPeakCur, HiPeakDv, HiPeakDvSum;
	U16						IrBufPrv, IrSizeDv;
	U8						DirStatus, DirUpCnt, DirDwCnt;
	U16						LoDirChangeCnt, HiDirChangeCnt;
	U16						LoTimePeak, HiTimePeak;
	U16						LoTimePrv, LoTimeDv, LoTimeDvSum;
	U16						HiTimePrv, HiTimeDv, HiTimeDvSum;
		
	if (DeviceType == DTYPE_TRIPLE)
		wc = 3;
	else {
		wc = 1;
		flame->IrLmtOffset[IR_WL_430] = pgm_read_byte( &IrLmtOffset_430[TempDv] );
	}
	
	for( wi=0; wi<wc; wi++, pIrBuf+=IR_BUF_SIZE )
	{
		PulseWidth = 1;
		
		if (flame == &Flame[0])		fp = &Flame[FLAME_BUFF_SIZE-1];
		else						fp = flame-1;
			
		Status = SPECTRUM_POSI_C;
		
		flame->Ir1sAvrg[wi] = 0;
		
		flame->IrLoFreq[wi] = 0;
		flame->IrLoTime[wi] = 0;
		flame->IrLoPeak[wi] = 1023;
		flame->IrLoAvrg[wi] = 0;
		
		flame->IrHiFreq[wi] = 0;
		flame->IrHiTime[wi] = 0;
		flame->IrHiPeak[wi] = 0;
		flame->IrHiAvrg[wi] = 0;
		
		LoCnt	= 0;
		HiCnt	= 0;
		
		if(FlameType == NON_HYDROCARBON)
		{
			//flame->IrAverDvSum[wi] = 0;
			flame->IrTimeDvSum[wi] = 0;
			//flame->IrPeakDvSum[wi] = 0;
			
			IrBufPrv = 0;
			DirStatus = IR_DIR_INIT;
			DirUpCnt = 0;
			DirDwCnt = 0;
			LoDirChangeCnt = 0;
			HiDirChangeCnt = 0;
			
			//iPeak	= 0;
			//LoPeakPrv	= 512;
			//LoPeakCur	= 512;
			//LoPeakDv	= 0;
			//LoPeakDvSum = 0;
			LoTimePeak	= 0;
			LoTimePrv	= 0;
			LoTimeDv	= 0;
			LoTimeDvSum	= 0;
			
			//HiPeakPrv	= 512;
			//HiPeakCur	= 512;
			//HiPeakDv	= 0;
			//HiPeakDvSum = 0;
			HiTimePeak	= 0;
			HiTimePrv	= 0;
			HiTimeDv	= 0;
			HiTimeDvSum = 0;
		}
		
		for (i = 0; i < IR_BUF_SIZE; i++)
		{
			IrBuf = *(pIrBuf+i);
			switch( Status )
			{
				case SPECTRUM_POSI_C:
					PulseWidth = 1;
					
					if (IrBuf < (IrLoLmt + flame->IrLmtOffset[IR_WL_430]))		Status = SPECTRUM_POSI_L;
					else if (IrBuf > (IrHiLmt + flame->IrLmtOffset[IR_WL_430]))	Status = SPECTRUM_POSI_H;
					break;
					
				case SPECTRUM_POSI_L:
					if (FlameType == NON_HYDROCARBON) 
					{
						if (( IrBuf >= (IrLoLmt + flame->IrLmtOffset[IR_WL_430]) ) || ( i == ( IR_BUF_SIZE-1 )))   // Lo 펄스 끝나는 조건
						{
							if ((i == ( IR_BUF_SIZE-1 )) && ( IrBuf < (IrLoLmt + flame->IrLmtOffset[IR_WL_430])))
								PulseWidth++;
							else	// 펄스에 대한 통계
							{
								if (( PulseWidth > IrDebTime ) && ( i > PulseWidth))
								{
									flame->IrLoFreq[wi] += 1;			// Lo 펄스
									flame->IrLoTime[wi] += PulseWidth;	// Lo 펄스 샘플수
							
									if (LoTimePrv > 0) {
										LoTimeDv = abs(LoTimePrv - PulseWidth);
										LoTimeDvSum += LoTimeDv;
									}
									LoTimePrv = PulseWidth;
									if (LoTimePeak < PulseWidth)
										LoTimePeak = PulseWidth;
								}
							}
														
							if( IrBuf > (IrHiLmt + flame->IrLmtOffset[IR_WL_430]) ){
								Status = SPECTRUM_POSI_H;
								PulseWidth = 1; // 2018-03-29 ���� 1:32:28
							}
							else	Status = SPECTRUM_POSI_C;
							
							DirUpCnt = 0;
							DirDwCnt = 0;
							DirStatus = IR_DIR_INIT;
						}
						else	// Lo 에서 계속 내려가는 구간
						{
							PulseWidth++;
							if (abs(IrBufPrv - IrBuf) > IR_DIR_DET_LMT)
							{
								if (IrBufPrv < IrBuf)
								{
									DirDwCnt = 0;
									DirUpCnt++;
									if (DirUpCnt > IR_DIR_CNT_LMT)
										DirStatus = IR_DIR_UP;
								}
								else
								{
									DirUpCnt = 0;
									DirDwCnt++;
									if (DirDwCnt > IR_DIR_CNT_LMT) 
									{
										if (DirStatus == IR_DIR_UP)
											LoDirChangeCnt++;
										DirStatus = IR_DIR_DOWN;
									}
								}
							}
						}
					}
					else  // HYDROCARBON
					{
						if (( IrBuf >= (IrLoLmt + flame->IrLmtOffset[IR_WL_430]) ) || ( i == ( IR_BUF_SIZE-1 )))
						{
							if (i == ( IR_BUF_SIZE-1))
								PulseWidth++;
							
							if (PulseWidth > IrDebTime) {
								flame->IrLoFreq[wi] += 1;
								flame->IrLoTime[wi] += PulseWidth;
							}
							
							if (IrBuf > (IrHiLmt + flame->IrLmtOffset[IR_WL_430])) {
								Status = SPECTRUM_POSI_H;
								PulseWidth = 1; // 2018-03-29 ���� 1:32:28
							}
							else	Status = SPECTRUM_POSI_C;
						}
						else	// Lo 에서 계속 내려가는 구간
						{
							PulseWidth++;
						}
					}
					break;
					
				case SPECTRUM_POSI_H:
					if (FlameType == NON_HYDROCARBON) 
					{
						if (( IrBuf <= (IrHiLmt + flame->IrLmtOffset[IR_WL_430]) ) || ( i == ( IR_BUF_SIZE-1 )))	// Hi 펄스 끝나는 조건
						{
							if ((i == ( IR_BUF_SIZE-1 )) && (IrBuf > (IrHiLmt + flame->IrLmtOffset[IR_WL_430]))) 
								PulseWidth++;
							else  // 펄스에 대한 통계
							{
								if (( PulseWidth > IrDebTime ) && ( i > PulseWidth))
								{
									flame->IrHiFreq[wi] += 1;				// Hi 펄스
									flame->IrHiTime[wi] += PulseWidth;      // Hi 펄스 샘플수

									if (HiTimePrv > 0) {
										HiTimeDv = abs(HiTimePrv - PulseWidth);
										HiTimeDvSum += HiTimeDv;
									}
									HiTimePrv = PulseWidth;
									if (HiTimePeak < PulseWidth)
										HiTimePeak = PulseWidth;
								}
							}
														
							if (IrBuf < (IrLoLmt + flame->IrLmtOffset[IR_WL_430])) {
								Status = SPECTRUM_POSI_L;
								PulseWidth = 1; // 2018-03-29 ���� 1:32:28
							}
							else	Status = SPECTRUM_POSI_C;
							
							DirUpCnt = 0;
							DirDwCnt = 0;
							DirStatus = IR_DIR_INIT;
						}
						else    // Hi 에서 올라가는 구간
						{
							PulseWidth++;
							if (abs(IrBufPrv - IrBuf) > IR_DIR_DET_LMT) 
							{
								if (IrBufPrv < IrBuf) {
									DirDwCnt = 0;
									DirUpCnt++;
									if (DirUpCnt > IR_DIR_CNT_LMT) {
										if (DirStatus == IR_DIR_DOWN) 
											HiDirChangeCnt++;
										DirStatus = IR_DIR_UP;
									}
								}
								else
								{
									DirUpCnt = 0;
									DirDwCnt++;
									if (DirDwCnt > IR_DIR_CNT_LMT)
										DirStatus = IR_DIR_DOWN;
								}
							}
						}
					}
					else	// HYDROCARBON
					{
						if (( IrBuf <= (IrHiLmt + flame->IrLmtOffset[IR_WL_430]) ) || ( i == ( IR_BUF_SIZE-1 )))
						{
							if (i == ( IR_BUF_SIZE-1))
								PulseWidth++;
							
							if (PulseWidth > IrDebTime) {
								flame->IrHiFreq[wi] += 1;
								flame->IrHiTime[wi] += PulseWidth;
							}
							
							if (IrBuf < (IrLoLmt + flame->IrLmtOffset[IR_WL_430])) {
								Status = SPECTRUM_POSI_L;
								PulseWidth = 1; // 2018-03-29 ���� 1:32:28
							}
							else	Status = SPECTRUM_POSI_C;
						}
						else 
						{
							PulseWidth++;
						}
					}
					break;
			} // end switch
			
			if (IrBuf < flame->IrLoPeak[wi])		flame->IrLoPeak[wi] = IrBuf;
			else if (IrBuf > flame->IrHiPeak[wi])	flame->IrHiPeak[wi] = IrBuf;
			
			if (IrBuf < 512) {
				LoCnt++;
				flame->IrLoAvrg[wi] += IrBuf;
			}
			else {
				HiCnt++;
				flame->IrHiAvrg[wi] += IrBuf;
			}
			
			flame->Ir1sAvrg[wi] += IrBuf;
			
			IrBufPrv = IrBuf;
		} // end for
		
		if (flame->IrLoFreq[wi] > 0) {
			//LoPeakDvSum = LoPeakDvSum / flame->IrLoFreq[wi];
			LoTimeDvSum = LoTimeDvSum / flame->IrLoFreq[wi];
		}
		
		if (flame->IrHiFreq[wi] > 0) {
			//HiPeakDvSum = HiPeakDvSum / flame->IrHiFreq[wi];
			HiTimeDvSum = HiTimeDvSum / flame->IrHiFreq[wi];
		}
		
		flame->IrTimeDvSum[wi] = LoTimeDvSum + HiTimeDvSum;		// 전체 IR 주기 변동성
		
		flame->IrWidestTimeSum[wi] = LoTimePeak + HiTimePeak;
		//flame->IrPeakDvSum[wi] = ( ((double)LoPeakDvSum + (double)HiPeakDvSum) ) * ADC_LSB ;
		
		flame->IrDirCntSum[wi] = HiDirChangeCnt + LoDirChangeCnt;	// IR 방향전환 횟수 (깜빡임)
		flame->IrFreqDirCntSum[wi] = flame->IrHiFreq[wi] + flame->IrLoFreq[wi] + flame->IrDirCntSum[wi];
						
		flame->IrLoPeak[wi] *= ADC_LSB;
		if (LoCnt)	flame->IrLoAvrg[wi] = flame->IrLoAvrg[wi] / LoCnt * ADC_LSB;
		else		flame->IrLoAvrg[wi] = flame->IrLoPeak[wi];
		
		flame->IrHiPeak[wi] *= ADC_LSB;
		if (HiCnt)	flame->IrHiAvrg[wi] = flame->IrHiAvrg[wi] / HiCnt * ADC_LSB;
		else		flame->IrHiAvrg[wi] = flame->IrHiPeak[wi];
		
		flame->Ir1sAvrg[wi] = flame->Ir1sAvrg[wi] / IR_BUF_SIZE * ADC_LSB;
		
		fBuf = flame->Ir1sAvrg[wi] - fp->Ir1sAvrg[wi];
		flame->Ir1sAvrgDv[wi] = fabs( fBuf );
				
		flame->Ir1sPtoP[wi] = flame->IrHiPeak[wi] - flame->IrLoPeak[wi];
		flame->IrAvPtoP[wi] = flame->IrHiAvrg[wi] - flame->IrLoAvrg[wi];
		
		if (flame->Ir1sPtoP[wi] == 0) {
			flame->IrAvPtoP[wi] = 5;
			flame->IrPtoPDvPer[wi] = 0;
		}
		else	flame->IrPtoPDvPer[wi] = ( fabs( fp->Ir1sPtoP[wi] - flame->Ir1sPtoP[wi] ) ) / flame->Ir1sPtoP[wi];
		
		/* ***********************************************************************************
			IrSpanBuf : Calibration parameter [V]
			IrAvPtoP  : 현재 [V] 값, 변수
			IrSpanVal : 구간별 기준값 (IR Size)
			IrSize    : 구하려는 IR Size -> 구간별 기울기와 구하려는 지점 기울기는 같다..
		*********************************************************************************** */	
		if( flame->IrAvPtoP[wi] > IrSpanBuf[wi][5] ){
			flame->IrSize[wi] = (U16)( IrSpanVal[wi][5] + ( flame->IrAvPtoP[wi] - IrSpanBuf[wi][5] ) / IrSlope[wi][6] );
		}
		else if( flame->IrAvPtoP[wi] > IrSpanBuf[wi][4] ){
			flame->IrSize[wi] = (U16)( IrSpanVal[wi][4] + ( flame->IrAvPtoP[wi] - IrSpanBuf[wi][4] ) / IrSlope[wi][5] );
		}
		else if( flame->IrAvPtoP[wi] > IrSpanBuf[wi][3] ){
			flame->IrSize[wi] = (U16)( IrSpanVal[wi][3] + ( flame->IrAvPtoP[wi] - IrSpanBuf[wi][3] ) / IrSlope[wi][4] );
		}
		else if( flame->IrAvPtoP[wi] > IrSpanBuf[wi][2] ){
			flame->IrSize[wi] = (U16)( IrSpanVal[wi][2] + ( flame->IrAvPtoP[wi] - IrSpanBuf[wi][2] ) / IrSlope[wi][3] );
		}
		else if( flame->IrAvPtoP[wi] > IrSpanBuf[wi][1] ){
			flame->IrSize[wi] = (U16)( IrSpanVal[wi][1] + ( flame->IrAvPtoP[wi] - IrSpanBuf[wi][1] ) / IrSlope[wi][2] );
		}
		else if( flame->IrAvPtoP[wi] > IrSpanBuf[wi][0] ){
			flame->IrSize[wi] = (U16)( IrSpanVal[wi][0] + ( flame->IrAvPtoP[wi] - IrSpanBuf[wi][0] ) / IrSlope[wi][1] );
		}
		else {	// flame->IrAvPtoP[wi] < IrSpanBuf[wi][0]
			flame->IrSize[wi] = (U16)( flame->IrAvPtoP[wi] / IrSlope[wi][0] );
		}
	

		if (flame->IrSize[wi] > 1000)	wSize[wi] = 1000;
		else							wSize[wi] = flame->IrSize[wi];
		
		if( flame->IrSize[wi] > fp->IrSize[wi] ){
			min = fp->IrSize[wi];
			max = flame->IrSize[wi];
		}
		else {
			min = flame->IrSize[wi];
			max = fp->IrSize[wi];
		}
		
		if( min == 0 ){
			flame->IrSizeRoc[wi] = 0;
		}
		else {
			flame->IrSizeRoc[wi] = (U16)(fabs(( min - max ) / min * 100 ));
			if( flame->IrSizeRoc[wi] > 999 ){
				flame->IrSizeRoc[wi] = 999;
			}
		}
		
		if( flame->IrSize[wi] == 0) flame->IrSizeDvPer[wi] = 0;
		else {
			IrSizeDv = abs(fp->IrSize[wi] - flame->IrSize[wi]);
			flame->IrSizeDvPer[wi] = ( (double)((double)IrSizeDv / (double)flame->IrSize[wi]) ) ;
		}
		
		if( wi == IR_WL_430 ){
			if( BIT_Status == BIT_STATE_IDLE ){
				if( flame->IrAvPtoP[IR_WL_430] > IrAvPtoPMax ){
					IrAvPtoPMax = flame->IrAvPtoP[IR_WL_430];
				}
			}
		}
		
		fBuf = flame->IrAvPtoP[wi] - fp->IrAvPtoP[wi];
		flame->IrAvPtoPDv[wi] = fabs( fBuf );
		
		FreqDv = (S16)flame->IrHiFreq[wi] - (S16)flame->IrLoFreq[wi];
		TimeDv = (S16)flame->IrHiTime[wi] - (S16)flame->IrLoTime[wi];
		
		flame->IrFreqDv[wi] = abs( FreqDv );
		flame->IrTimeDv[wi] = abs( TimeDv );
		
		if( !flame->IrLoFreq[wi] && !flame->IrHiFreq[wi] ){
			if( IrNonDetCnt[wi] != 0xFF ){
				IrNonDetCnt[wi]++;
			}
		}
		else {
			if(( IrNonDetCnt[wi] >= IR_FSO_TIME ) || ( BIT_Status != BIT_STATE_IDLE )){
				flame->IrLoFreq[wi] = 0;
				flame->IrHiFreq[wi] = 0;
			}
			if( BIT_Status == BIT_STATE_IDLE ){
				IrNonDetCnt[wi] = 0;
			}
		}
	}

// **************************************************************************************************************
	//flame->IrRatioLmt[IR_WL_395] = pgm_read_float( &IR_Rel_Ratio_Limit_395[wSize[IR_WL_430]] );
	//flame->IrRatioLmt[IR_WL_530] = pgm_read_float( &IR_Rel_Ratio_Limit_530[wSize[IR_WL_430]] );
	//printf(" f %f \r\n", flame->IrRatioLmt[IR_WL_395]);
	//printf(" SZ: %d, Lmt395: %.1f, Lmt530: %.1f  \r\n", wSize[IR_WL_430], flame->IrRatioLmt[IR_WL_395], flame->IrRatioLmt[IR_WL_530]);	
	
	//flame->IrRatioLmt[IR_WL_395] = EEP_Rd(TRIPLE_IR_REL_RATIO_395_SIZE_1) / 10.0f;
	//printf(" e %f \r\n", flame->IrRatioLmt[IR_WL_395]);
	
	// jmyoo
	if (wSize[IR_WL_430] == 0 || wSize[IR_WL_430] == 1) {
		flame->IrRatioLmt[IR_WL_395] = EEP_Rd(TRIPLE_IR_REL_RATIO_395_SIZE_1) / 10.0f;
		flame->IrRatioLmt[IR_WL_530] = EEP_Rd(TRIPLE_IR_REL_RATIO_530_SIZE_1) / 10.0f;
		
	} else if (wSize[IR_WL_430] % 2 == 1) {	// odd
		flame->IrRatioLmt[IR_WL_395] = EEP_Rd( TRIPLE_IR_REL_RATIO_395_SIZE_1 + (wSize[IR_WL_430]-1)/2 ) / 10.0f;
		flame->IrRatioLmt[IR_WL_530] = EEP_Rd( TRIPLE_IR_REL_RATIO_530_SIZE_1 + (wSize[IR_WL_430]-1)/2 ) / 10.0f;
		
	} else if (wSize[IR_WL_430] % 2 == 0) {	// even
		flame->IrRatioLmt[IR_WL_395] = EEP_Rd( TRIPLE_IR_REL_RATIO_395_SIZE_1 + (wSize[IR_WL_430]/2 -1) ) / 10.0f;
		flame->IrRatioLmt[IR_WL_530] = EEP_Rd( TRIPLE_IR_REL_RATIO_530_SIZE_1 + (wSize[IR_WL_430]/2 -1) ) / 10.0f;
	}
	
	//printf(" Algo~  Lmt395: %.1f, Lmt530: %.1f  \r\n", flame->IrRatioLmt[IR_WL_395], flame->IrRatioLmt[IR_WL_530]);	
// **************************************************************************************************************	
	if(wSize[IR_WL_430] <= IR_395_OFFSET_LMT){
		flame->IrRatioLmt[IR_WL_395] += IrRelRatioCorrVal_395;     
		//flame->IrRatioLmt[IR_WL_395] += (float)IrRelRatioCorrVal_395/10;      
	}  
	if(flame->IrRatioLmt[IR_WL_395] >= 99.8) {
		flame->IrRatioLmt[IR_WL_395] = 99.8;
	}
	if(wSize[IR_WL_430] <= IR_530_OFFSET_LMT){
		flame->IrRatioLmt[IR_WL_530] += IrRelRatioCorrVal_530;   
		//flame->IrRatioLmt[IR_WL_530] += (float)IrRelRatioCorrVal_530/10;
	}  
	if(flame->IrRatioLmt[IR_WL_530] >= 99.8) {
		flame->IrRatioLmt[IR_WL_530] = 99.8;
	}
	
	flame->IrRelRatio[IR_WL_395] = (double)wSize[IR_WL_395] / (double)wSize[IR_WL_430] * 100;
	flame->IrRelRatio[IR_WL_530] = (double)wSize[IR_WL_530] / (double)wSize[IR_WL_430] * 100;
	
	if( DeviceType == DTYPE_UVIR )
	{
		switch( IrNonDetCnt[IR_WL_430] )
		{
			case 0:
				if(( BIT_Status == BIT_STATE_IDLE ) && ( AlarmState != ALARM_STATE_FLAME )){
					SMPS_ON();
				}
				break;
				
			case UV_POWER_RET_TIME:
				if( BIT_Status == BIT_STATE_IDLE ){
					if( UvPwrCtrlFlag ){
						SMPS_OFF();
					}
				}
				else {
					IrNonDetCnt[IR_WL_430]--;
				}
				break;
		}
	}
}

/////////////////////////////////////////////////////////////////////////////////////////////////////////////////////////////////////

void IR_Detection( U8 index )
{
	double	Fref[3];
	double	Ir1sAvDvLmt;
	U16		i, iPrev;
	U16		LoTimeDv, HiTimeDv, IrFreqSum, IrWidestTimeSumDv;
	U16		SizeDv;
	U8		bFlag = 0, Cnt;
	U16		Cps[3];
	
	if( index == 0 ){
		iPrev = FLAME_BUFF_SIZE-1;
	}
	else {
		iPrev = index-1;
	}
	
	if(FlameType == NON_HYDROCARBON)
	{
		IrFreqSum = Flame[index].IrLoFreq[IR_WL_430] + Flame[index].IrHiFreq[IR_WL_430];
		
		if( (( IrFreqSum < IrFreqSumLmt ) &&  ( Flame[iPrev].IrDirCntSum == 0 ) && ( Flame[index].IrDirCntSum == 0 )) ||
			(( Flame[index].IrLoFreq[IR_WL_430] == 0 ) &&  ( Flame[iPrev].IrDirCntSum[IR_WL_430] == 0 ) && ( Flame[index].IrDirCntSum[IR_WL_430] == 0 )) ||
			(( Flame[index].IrHiFreq[IR_WL_430] == 0 ) &&  ( Flame[iPrev].IrDirCntSum[IR_WL_430] == 0 ) && ( Flame[index].IrDirCntSum[IR_WL_430] == 0 )) ){
			bFlag |= 0x80;
		}
		
		if( Flame[index].UvCpsItg > UvDetLmtOnIrSizeLmtChange ) {
			if( Flame[index].IrSize[IR_WL_430] < IrSizeLmt_NHC ){
				bFlag |= 0x40;
			}	
		}
		else {
			if( Flame[index].IrSize[IR_WL_430] < IrSizeLmtOnNonOperFlame ){
				bFlag |= 0x40;
			}
		}
	}
	else 
	{
		if(( Flame[index].IrLoFreq[IR_WL_430] == 0 ) && ( Flame[index].IrHiFreq[IR_WL_430] == 0 )){
			bFlag |= 0x80;
		}
		if( Flame[index].IrSize[IR_WL_430] < IrSizeLmt ){
			bFlag |= 0x40;
		}
	}
	
	if( DeviceType == DTYPE_UVIR )
	{
		LoTimeDv = abs((S16)Flame[index].IrLoTime[IR_WL_430] - (S16)Flame[iPrev].IrLoTime[IR_WL_430]);
		HiTimeDv = abs((S16)Flame[index].IrHiTime[IR_WL_430] - (S16)Flame[iPrev].IrHiTime[IR_WL_430]);
		
		if(FlameType == NON_HYDROCARBON){
			IrWidestTimeSumDv = abs((S16)Flame[index].IrWidestTimeSum[IR_WL_430] - (S16)Flame[iPrev].IrWidestTimeSum[IR_WL_430]);
			
			if( ( Flame[index].IrLoTime[IR_WL_430] == Flame[iPrev].IrLoTime[IR_WL_430] ) &&
				( Flame[index].IrHiTime[IR_WL_430] == Flame[iPrev].IrHiTime[IR_WL_430] ) &&
				( LoTimeDv < IrTimeDvLmtInFreqSame_NHC) && ( HiTimeDv < IrTimeDvLmtInFreqSame_NHC) && 
				( Flame[iPrev].IrDirCntSum[IR_WL_430] < IrDirCntSumLmt ) && 
				( Flame[index].IrDirCntSum[IR_WL_430] < IrDirCntSumLmt ) ){
				bFlag |= 0x20;
			}
			
			if( ( IrWidestTimeSumDv < IrTimeDvSumLmt ) && ( Flame[index].IrTimeDvSum[IR_WL_430] < IrTimeDvSumLmt ) &&
				( Flame[iPrev].IrDirCntSum[IR_WL_430] == 0 ) && ( Flame[index].IrDirCntSum[IR_WL_430] == 0 ) ){
				bFlag |= 0x10;
			}
			
			if( ( Flame[index].IrSizeDvPer[IR_WL_430] < IrSizeDvPerLmt ) && ( Flame[index].UvCpsRaw < UvCpsLmtInIrSizeDvPer ) &&
				( ( Flame[index].IrLoFreq[IR_WL_430] == 0 ) || ( Flame[index].IrHiFreq[IR_WL_430] == 0 ) ) ){
				bFlag |= 0x08;
			}
			
			if( ( Flame[iPrev].IrDirCntSum[IR_WL_430] == 0 ) && ( Flame[index].IrDirCntSum[IR_WL_430] == 0 ) &&
				( Flame[index].IrTimeDvSum[IR_WL_430] < IrTimeDvSumLmtInCntZr ) ){
				bFlag |= 0x04;	
			}
			
			if( ( Flame[index].IrSizeDvPer[IR_WL_430] < IrSizeDvPerLmt ) && 
				( Flame[iPrev].IrSizeDvPer[IR_WL_430] < IrSizeDvPerLmt ) &&
				( Flame[index].IrPtoPDvPer[IR_WL_430] < IrPtoPDvPerLmt ) &&
				( Flame[iPrev].IrPtoPDvPer[IR_WL_430] < IrPtoPDvPerLmt ) && 
				( Flame[index].Ir1sPtoP[IR_WL_430] < IR_PtoP_SATURATION ) ){
				bFlag |= 0x02;	
			}
			
		}
		else{
			if( ( Flame[index].IrLoFreq[IR_WL_430] == Flame[iPrev].IrLoFreq[IR_WL_430] ) && ( LoTimeDv < IrTimeDvLmtInFreqSame ) &&
			( Flame[index].IrHiFreq[IR_WL_430] == Flame[iPrev].IrHiFreq[IR_WL_430] ) && ( HiTimeDv < IrTimeDvLmtInFreqSame )){
				bFlag |= 0x20;
			}
			
			Cps[index] = Flame[index].UvCpsRes;
			Cps[iPrev] = Flame[iPrev].UvCpsRes;
			if( Cps[index] > IrFlickerCpsRefLmt ){
				Cps[index] = IrFlickerCpsRefLmt;
			}
			if( Cps[iPrev] > IrFlickerCpsRefLmt ){
				Cps[iPrev] = IrFlickerCpsRefLmt;
			}
			Fref[index] = Cps[index] * IrFlickerFactor;
			Fref[iPrev] = Cps[iPrev] * IrFlickerFactor;
			
			if(( Flame[index].Ir1sAvrgDv[IR_WL_430] < Fref[index] ) && ( Flame[iPrev].Ir1sAvrgDv[IR_WL_430] < Fref[iPrev] )){
				bFlag |= 0x10;
			}
			if(( Flame[index].IrAvPtoPDv[IR_WL_430] < Fref[index] ) && ( Flame[iPrev].IrAvPtoPDv[IR_WL_430] < Fref[iPrev] )){
				bFlag |= 0x08;
			}
			
			if( Flame[index].Ir1sAvrgDv[IR_WL_430] > Ir1sAvrgDvOverLmt ){
				bFlag |= 0x04;
			}
			
			if( Flame[index].UvCpsRaw > IrLoSizeLmtCpsRef ){
				if( Flame[index].IrSize[IR_WL_430] < IrLoSizeLmt ){
					bFlag |= 0x02;
				}
			}
		}
	}
	else 
	{
		if(( Flame[iPrev].IrRelRatio[IR_WL_395] > Flame[iPrev].IrRatioLmt[IR_WL_395] ) || ( Flame[index].IrRelRatio[IR_WL_395] > Flame[index].IrRatioLmt[IR_WL_395] )){
			bFlag |= 0x20;
		}
		
		if(( Flame[iPrev].IrRelRatio[IR_WL_530] > Flame[iPrev].IrRatioLmt[IR_WL_530] ) || ( Flame[index].IrRelRatio[IR_WL_530] > Flame[index].IrRatioLmt[IR_WL_530] )){
			bFlag |= 0x10;
		}
		
		if(( Flame[index].IrSizeRoc[IR_WL_430] > IrSizeRocLmt ) || ( Flame[index].IrSizeRoc[IR_WL_395] > IrSizeRocLmt ) || ( Flame[index].IrSizeRoc[IR_WL_530] > IrSizeRocLmt )){
			bFlag |= 0x08;
		}
		
		LoTimeDv = abs((S16)Flame[index].IrLoTime[IR_WL_430] - (S16)Flame[iPrev].IrLoTime[IR_WL_430]);
		HiTimeDv = abs((S16)Flame[index].IrHiTime[IR_WL_430] - (S16)Flame[iPrev].IrHiTime[IR_WL_430]);
		SizeDv = abs((S16)Flame[index].IrSize[IR_WL_430] - (S16)Flame[iPrev].IrSize[IR_WL_430]);

		if(Flame[index].IrSize[IR_WL_430] > 900 && Flame[iPrev].IrSize[IR_WL_430] > 900){
			Ir1sAvDvLmt = Ir1sAvDvLmtInFreqSame * 5;
		}
		else{
			Ir1sAvDvLmt = Ir1sAvDvLmtInFreqSame;
		}

		if( ( Flame[index].IrLoFreq[IR_WL_430] == Flame[iPrev].IrLoFreq[IR_WL_430] ) && ( LoTimeDv < IrTimeDvLmtInFreqSame ) &&
			( Flame[index].IrHiFreq[IR_WL_430] == Flame[iPrev].IrHiFreq[IR_WL_430] ) && ( HiTimeDv < IrTimeDvLmtInFreqSame ) &&
			( Flame[index].Ir1sAvrgDv[IR_WL_430] < Ir1sAvDvLmt ) && ( Flame[iPrev].Ir1sAvrgDv[IR_WL_430] < Ir1sAvDvLmt ) &&
			( SizeDv < IrSizeDvLmtInFreqSame )){
			bFlag |= 0x04;
		}
		
		if( Flame[index].IrTimeDv[IR_WL_430] > TripModeIrTimeDvLmt ){
			bFlag |= 0x02;
		}
	}
	
	if( mmi_mode == FMODE_WARM_UP ){
		Flame[index].IrFtFlag = 0xFF;
	}
	else {
		Flame[index].IrFtFlag = bFlag;
	}
	
	for( i=0, Cnt=0; i<3; i++ ){
		if( Flame[i].IrFtFlag == 0 ){
			Cnt++;
		}
	}
	
	Flame[index].IrCnt = Cnt;
}

/////////////////////////////////////////////////////////////////////////////////////////////////////////////////////////////////////

void IR_Slope_Calculator( U8 wl, U8 n )
{
	if (n)	IrSlope[wl][n] = ( IrSpanBuf[wl][n] - IrSpanBuf[wl][n-1] ) / ( IrSpanVal[wl][n] - IrSpanVal[wl][n-1] );
	else	IrSlope[wl][n] = IrSpanBuf[wl][n] / IrSpanVal[wl][n];
}

/////////////////////////////////////////////////////////////////////////////////////////////////////////////////////////////////////

void IR430_Calibration( S16 Responsivity )
{
	double	fScale;
	S16		CalBuf[7], i;
		
	if( DeviceType == DTYPE_TRIPLE ){
		return;
	}
	
	fScale = (double)Responsivity / 1990;
	
	for( i=EEP_CAL_BUF_IR430_01; i<=EEP_CAL_BUF_IR430_07; i++ ){
		CalBuf[i-EEP_CAL_BUF_IR430_01] = (S16)((double)pgm_read_word( &EEP_SYS_DEFAULT[i] ) * fScale);
		epr_sm[i] = CalBuf[i-EEP_CAL_BUF_IR430_01];
		EEP_Wr( i, epr_sm[i] );
	}
	
	EEP_CRC_Wr(EEP_BLOCK_1);
	
	if( EEP_CRC_Check(EEP_BLOCK_1) ){
		EepErrorFlag = EEP_CAL_BUF_IR430_01;
	}
	else {
		EepErrorFlag = 0;
		
		for( i=EEP_CAL_BUF_IR430_01; i<=EEP_CAL_BUF_IR430_07; i++ ){
			IrSpanBuf[IR_WL_430][i-EEP_CAL_BUF_IR430_01] = ((double)pgm_read_word( &EEP_SYS_DEFAULT[i] ) * 0.001);
		}
		for( i=0; i<7; i++ ){
			IR_Slope_Calculator( IR_WL_430, i );
		}
	}
	
	sTimerFlag[TMR_MODBUS_TIMEOUT] = 0;
}

/*
*******************************************************************************
* COPYRIGHT (c) 1992-2012 GASTRON Co.,Ltd. All rights reserved.
*******************************************************************************
* Model Name	: GTF-1100 Series
* Module name	: 
* Description	: 
* Version		: REV 0.51
* Start Date	: 2017.01.17
* Modify Date	: 2018.06.14
* C-Compiler	: avr-gcc
* MPU			: ATmega1281
* Written by	: Min-Sung, Kang (mskang@gastron.com)
*******************************************************************************
*/

/////////////////////////////////////////////////////////////////////////////////////////////////////////////////////////////////////

#include <stdio.h>
#include <ctype.h>
#include <string.h>

#include <avr/eeprom.h>
#include <avr/pgmspace.h>

/////////////////////////////////////////////////////////////////////////////////////////////////////////////////////////////////////

#include "global.h"
#include "dbg_printf.h"

#include "eep.h"
#include "modbus.h"
#include "ir.h"
#include "uv.h"
#include "gpio.h"
#include "sw_lib.h"
#include "timer.h"

/////////////////////////////////////////////////////////////////////////////////////////////////////////////////////////////////////

U16			EepErrorFlag;

/////////////////////////////////////////////////////////////////////////////////////////////////////////////////////////////////////

const S16 	EEP_SYS_DEFAULT[]PROGMEM =
{
	0x1234,
	0,											// EEP_CHECKSUM_1
	EEPROM_MARKING_1,							// EEP_PREFIX_1
	0,											// EEP_SERIAL_NO_L
	0,											// EEP_SERIAL_NO_H
	LMODE_NO,									// EEP_LOG_MODE
	BIT_MODE_AUTO,								// EEP_BIT_MODE
	1,											// EEP_UV_PWR_CTRL
	2400,										// EEP_UVIR_IR_VOLT_LMT_L
	2600,										// EEP_UVIR_IR_VOLT_LMT_H
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	150,										// EEP_IR_FLICKER_CPS_REF_LMT
	IR_FLICKER_FACTOR*10000,					// EEP_IR_FLICKER_FACTOR
	IR_TIME_DV_LMT_IN_FREQ_SAME,				// EEP_IR_TIME_DV_LMT_IN_FREQ_SAME
	50,											// EEP_IR_1SAV_DV_LMT_IN_FREQ_SAME
	10,											// EEP_IR_SIZE_DV_LMT_IN_FREQ_SAME
	IR_LOW_SIZE_LMT_CPS_REF,					// EEP_IR_LOW_SIZE_LMT_CPS_REF
	IR_LOW_SIZE_LMT,							// EEP_IR_LOW_SIZE_LMT
	1700,										// EEP_IR_1S_AVRG_DV_OVER_LMT
	300,										// EEP_IR_BIT_THRESHOLD_VOLT
	250,										// EEP_IR_ROC_LMT
	0,											// EEP_IR_REL_RATIO_LMT_CORR_VAL
	UV_DET_LIMIT*1000,							// EEP_UV_DET_LMT
	UV_ZERO_DEV_CNT_LMT,						// EEP_UV_ZERO_DEV_CNT_LMT
	UV_ZERO_CNT_LMT_CPS_REF,					// EEP_UV_ZERO_CNT_LMT_CPS_REF
	UV_ZERO_CNT_LMT,							// EEP_UV_ZERO_CNT_LMT
	UV_ROC_LMT_CPS_REF,							// EEP_UV_ROC_LMT_CPS_REF
	UV_ROC_LMT,									// EEP_UV_ROC_LMT
	5,											// EEP_UV_BIT_THRESHOLD_CPS
	60,											// EEP_BIT_PERIOD
	9,											// EEP_BIT_RETRY_LMT
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	988,										// EEP_CAL_VAL_IR530_07
	UV_ZERO_CNT_DEV_LMT,						// EEP_UV_ZERO_CNT_DEV_LMT
	100,										// EEP_TRIPMODE_IR_TIME_DV_LMT	
	5000,										// EEP_EVT_BIT_IR430_1S_PTOP_MIN
	5000,										// EEP_EVT_BIT_IR395_1S_PTOP_MIN
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	0,											// EEP_EVT_IR530_DRIFT_T_MAX_H
	HYDROCARBON,								// EEP_FLAME_TYPE
	EEPROM_MARKING_2,							// EEP_PREFIX_2
	UVIR_SIZE_LMT_NHC,							// EEP_UVIR_SIZE_LMT_NHC
	IR_LOW_SIZE_LMT_CPS_REF_NHC,				// EEP_IR_LOW_SIZE_LMT_CPS_REF_NHC
	IR_LOW_SIZE_LMT_NHC,						// EEP_IR_LOW_SIZE_LMT_NHC
	IR_FREQ_SUM_LMT,							// EEP_IR_FREQ_SUM_LMT
	IR_DIR_CNT_SUM_LMT,							// EEP_IR_DIR_CNT_SUM_LMT
	IR_TIME_DV_SUM_LMT,							// EEP_IR_TIME_DV_SUM_LMT
	IR_TIME_DV_SUM_LMT_IN_CNT_ZERO,				// EEP_IR_TIME_DV_SUM_LMT_IN_CNT_ZERO
	IR_FREQ_ADD_CNT_LMT,						// EEP_IR_FREQ_ADD_CNT_LMT
	IR_DIR_CNT_LMT_IN_TIME_SAME,				// EEP_IR_DIR_CNT_LMT_IN_TIME_SAME
	IR_SIZE_LMT_IN_IR_SIZE_DV_PER,				// EEP_IR_SIZE_LMT_IN_IR_SIZE_DV_PER
	IR_SIZE_DV_PER_LMT * 100,					// EEP_IR_SIZE_DV_PER_LMT
	IR_PTOP_DV_PER_LMT * 100,					// EEP_IR_PTOP_DV_PER_LMT
	IR_TIME_DV_LMT_IN_FREQ_SAME_NHC,			// EEP_IR_TIME_DV_LMT_IN_FREQ_SAME_NHC
	UV_CPS_LMT_IN_IR_SIZE_DV_PER,				// EEP_UV_CPS_LMT_IN_IR_SIZE_DV_PER
	UV_ZERO_CNT_LMT_CPS_REF_NHC,				// EEP_UV_ZERO_CNT_LMT_CPS_REF_NHC
	UV_ZERO_CNT_DEV_LMT_NHC,					// EEP_UV_ZERO_CNT_DEV_LMT_NHC
	FREQ_ADD_CNT_LMT_IN_UVIR_VALANCE,			// EEP_FREQ_ADD_CNT_LMT_IN_UVIR_VALANCE
	FREQ_ADD_CNT_LMT_IN_UV_ZERO_CNT,			// EEP_FREQ_ADD_CNT_LMT_IN_UV_ZERO_CNT
	IR_DIR_CNT_LMT_IN_UV_ZERO_CNT,				// EEP_IR_DIR_CNT_LMT_IN_UVIR_VALANCE
	UV_ROC_LMT_CPS_REF_NHC,						// EEP_UV_ROC_LMT_CPS_REF_NHC
	UV_ROC_LMT_NHC,								// EEP_UV_ROC_LMT_NHC
	UVIR_SIZE_LMT_NON_OPER_FLAME,				// EEP_IR_SIZE_LMT_ON_NON_OPER_FLAME		
	UV_DET_LIMIT_ON_IR_SIZE_LMT_CHANGE * 1000,	// EEP_UV_DET_LMT_ON_IR_SIZE_LMT_CHANGE
	0,											// EEP_FLAME_DETECTION_DELAY_TIME
	0,											// EEP_RESERVED_0
	0,											// EEP_RESERVED_1
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	0,											// EEP_CHECKSUM_2
	EEP_MAX,									// EEP_MAX	

	0,											// EEP_RATIO_RESERVED
	0,											// EEP_RATIO_CHECKSUM
	EEPROM_RATIO_MARKING,						// EEP_RATIO_PREFIX						
	150,										// TRIPLE_IR_REL_RATIO_395_SIZE_1
	201,										// TRIPLE_IR_REL_RATIO_395_SIZE_3
	455,										// TRIPLE_IR_REL_RATIO_395_SIZE_5
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	998, 										// TRIPLE_IR_REL_RATIO_530_SIZE_999
	TRIPLE_IR_REL_RATIO_MAX						// TRIPLE_IR_REL_RATIO_MAX
};

const S16 	EEP_SYS_LO_LIMIT[]PROGMEM =
{
	0,
	0,											// EEP_CHECKSUM_1
	0,											// EEP_PREFIX_1
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	0,											// TRIPLE_IR_REL_RATIO_MAX
};

const S16 	EEP_SYS_UP_LIMIT[]PROGMEM =
{
	0,
	0,											// EEP_CHECKSUM_1
	0,											// EEP_PREFIX_1
	32767,										// EEP_SERIAL_NO_L
	32767,										// EEP_SERIAL_NO_H
	LMODE_UV_ONLY,								// EEP_LOG_MODE
	BIT_MODE_MANUAL,							// EEP_BIT_MODE
	1,											// EEP_UV_PWR_CTRL
	2600,										// EEP_UVIR_IR_VOLT_LMT_L
	2800,										// EEP_UVIR_IR_VOLT_LMT_H
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	32767,										// EEP_EVT_IR530_DRIFT_T_MAX_H
	FTYPE_MAX,									// EEP_FLAME_TYPE
	0,											// EEP_PREFIX_2
	100,										// EEP_UVIR_SIZE_LMT_NHC
	300,										// EEP_IR_LOW_SIZE_LMT_CPS_REF_NHC
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	0,											// EEP_RATIO_PREFIX
	
// 395 up_lmt �缱��, 2025-11-06	
	998,										// TRIPLE_IR_REL_RATIO_395_SIZE_1
	998,										// TRIPLE_IR_REL_RATIO_395_SIZE_3
	998,										// TRIPLE_IR_REL_RATIO_395_SIZE_5
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	998,										// TRIPLE_IR_REL_RATIO_395_SIZE_999
	
// 530 up_lmt �缱��, 2025-11-06		
	998, 										// TRIPLE_IR_REL_RATIO_530_SIZE_1
	998, 										// TRIPLE_IR_REL_RATIO_530_SIZE_3
	998, 										// TRIPLE_IR_REL_RATIO_530_SIZE_5
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	0,											// TRIPLE_IR_REL_RATIO_MAX
};

/////////////////////////////////////////////////////////////////////////////////////////////////////////////////////////////////////

S16		epr_sm[EEP_MAX];

/////////////////////////////////////////////////////////////////////////////////////////////////////////////////////////////////////

void EEP_Wr( U16 addr, S16 data );
U16 EEP_Rd( U16 addr );
void EEP_CRC_Wr( U8 Eep_Block );
U8 EEP_CRC_Check( U8 Eep_Block );
void EEP_Load( void );
void EEP_SysFormat( U8 Eep_Block );
void EEP_Flame_Count_Log( void );
void EEP_Flame_Count_Clr( void );

/////////////////////////////////////////////////////////////////////////////////////////////////////////////////////////////////////

void EEP_Wr( U16 addr, S16 data )
{
	U16		wadd;
	
	wadd = addr*2;
	
	if(( wadd < EEPROM_SIZE ) && ( P24 > 17.f )){
		eeprom_update_word( (U16*)wadd, data );
	}
}

/////////////////////////////////////////////////////////////////////////////////////////////////////////////////////////////////////

void EEP_Sys_Wr( U16 addr, S16 data )
{
	U8 Eep_Block = 0;
	
	if( addr < EEP_MAX ) epr_sm[addr] = data;
	
	EEP_Wr( addr, data );
	
	Eep_Block = EEP_Block_Check( addr );	
	EEP_CRC_Wr(Eep_Block);
	
	if( EEP_CRC_Check(Eep_Block) ){
		EepErrorFlag = addr;
	}
	else {
		EepErrorFlag = 0;
		switch( addr ){
			case EEP_LOG_MODE:
				LogMode = epr_sm[addr];
				break;
				
			case EEP_BIT_MODE:
				BIT_Mode = epr_sm[addr];
				if( BIT_Mode == BIT_MODE_AUTO ){
					sTimerTick[TMR_BIT_PERIOD] = 0x8000+1499;
					sTimerFlag[TMR_BIT_PERIOD] = 0;
				}
				else {
					sTimerTick[TMR_BIT_PERIOD] = 0;
					sTimerFlag[TMR_BIT_PERIOD] = 0;
				}
				break;
				
			case EEP_UV_PWR_CTRL:
				UvPwrCtrlFlag = epr_sm[addr];
				if( UvPwrCtrlFlag ){
					if( SMPS_PORT_CHK() ){
						if(( IrNonDetCnt[IR_WL_430] >= UV_POWER_RET_TIME ) && ( BIT_Status == BIT_STATE_IDLE )){
							SMPS_OFF();
						}
					}
				}
				else {
					if( !SMPS_PORT_CHK() ){
						SMPS_ON();
					}
				}
				break;
				
			case EEP_FLAME_TYPE:
				FlameType = epr_sm[addr];
				break;
				
			case EEP_UVIR_IR_VOLT_LMT_L:
			case EEP_TRIP_IR_VOLT_LMT_L:
				IrLoLmt = epr_sm[addr] * 0.001 / ADC_LSB;
				break;
				
			case EEP_UVIR_IR_VOLT_LMT_H:
			case EEP_TRIP_IR_VOLT_LMT_H:
				IrHiLmt = epr_sm[addr] * 0.001 / ADC_LSB;
				break;
				
			case EEP_UVIR_IR_SIZE_LMT:
			case EEP_TRIP_IR_SIZE_LMT:
				IrSizeLmt = epr_sm[addr];
				break;
			
							
			case EEP_IR_PULSE_WIDTH_LMT:
				IrDebTime = epr_sm[addr];
				break;
				
			case EEP_IR_FLICKER_CPS_REF_LMT:
				IrFlickerCpsRefLmt = epr_sm[addr];
				break;
				
			case EEP_IR_FLICKER_FACTOR:
				IrFlickerFactor = ((double)epr_sm[addr] / 10000 );
				break;
			
			//non-Hydrocarbon
				
			case EEP_UVIR_SIZE_LMT_NHC:
				IrSizeLmt_NHC = epr_sm[addr];
				break;
			
			case EEP_IR_LOW_SIZE_LMT_CPS_REF_NHC:
				IrLoSizeLmtCpsRef_NHC = epr_sm[addr];
				break;
			
			case EEP_IR_LOW_SIZE_LMT_NHC:
				IrLoSizeLmt_NHC = epr_sm[addr];
				break;
			
			case EEP_IR_FREQ_SUM_LMT:
				IrFreqSumLmt = epr_sm[addr];
				break;
				
			case EEP_IR_DIR_CNT_SUM_LMT:
				IrDirCntSumLmt = epr_sm[addr];
				break;
			
			case EEP_IR_TIME_DV_SUM_LMT:
				IrTimeDvSumLmt = epr_sm[addr];
				break;
			
			case EEP_IR_TIME_DV_SUM_LMT_IN_CNT_ZERO:
				IrTimeDvSumLmtInCntZr = epr_sm[addr];
				break;
			
			case EEP_IR_FREQ_ADD_CNT_LMT:
				IrFreqAddCntLmt = epr_sm[addr];
				break;
			
			case EEP_IR_DIR_CNT_LMT_IN_TIME_SAME:
				IrDirCntLmtInTimeSame = epr_sm[addr];
				break;
			
			case EEP_IR_SIZE_LMT_IN_IR_SIZE_DV_PER:
				IrSizeLmtInSizeDvPer = epr_sm[addr];
				break;
			
			case EEP_IR_SIZE_DV_PER_LMT:
				IrSizeDvPerLmt = ((double)epr_sm[addr] / 100 );
				break;
			
			case EEP_IR_PTOP_DV_PER_LMT:
				IrPtoPDvPerLmt = ((double)epr_sm[addr] / 100 );
				break;
					
			case EEP_IR_TIME_DV_LMT_IN_FREQ_SAME_NHC:
				IrTimeDvLmtInFreqSame_NHC = epr_sm[addr];
				break;
			
			case EEP_UV_CPS_LMT_IN_IR_SIZE_DV_PER:
				IrSizeLmtInSizeDvPer = epr_sm[addr];
				break;
			
			case EEP_UV_ZERO_CNT_LMT_CPS_REF_NHC:
				UvZrLmtCpsRef_NHC = epr_sm[addr];
				break;
				
			case EEP_UV_ZERO_CNT_DEV_LMT_NHC:
				UvZrCntDvLmt_NCH = epr_sm[addr];
				break;
				
			case EEP_FREQ_ADD_CNT_LMT_IN_UVIR_VALANCE:
				FreqAddCntLmtInUvIrValance = epr_sm[addr];
				break;
			
			case EEP_FREQ_ADD_CNT_LMT_IN_UV_ZERO_CNT:
				FreqAddCntLmtInUvZrCnt = epr_sm[addr];
				break;	
			
			case EEP_IR_DIR_CNT_LMT_IN_UV_ZERO_CNT:
				IrDirCntLmtInUvZrCnt = epr_sm[addr];
				break;
				
			case EEP_UV_ROC_LMT_CPS_REF_NHC:
				UvRocLmtCpsRef_NHC = epr_sm[addr];
				break;
			
			case EEP_UV_ROC_LMT_NHC:
				UvRocLmt_NHC = epr_sm[addr];
				break;
			
			case EEP_IR_SIZE_LMT_ON_NON_OPER_FLAME:
				IrSizeLmtOnNonOperFlame = epr_sm[addr];
				break;
			
			case EEP_UV_DET_LMT_ON_IR_SIZE_LMT_CHANGE:
				UvDetLmtOnIrSizeLmtChange = ((double)epr_sm[addr] / 1000 );
				break;
			
			//	
			// jmyoo
			case EEP_FLAME_DETECTION_DELAY_TIME:
				FlameDetDelay_Sec = epr_sm[addr];
				break;
							
			case EEP_IR_TIME_DV_LMT_IN_FREQ_SAME:
				IrTimeDvLmtInFreqSame = epr_sm[addr];
				break;
			
			case EEP_IR_1SAV_DV_LMT_IN_FREQ_SAME:
				Ir1sAvDvLmtInFreqSame = ((double)epr_sm[addr] * 0.001 );
				break;
				
			case EEP_IR_SIZE_DV_LMT_IN_FREQ_SAME:
				IrSizeDvLmtInFreqSame = epr_sm[addr];
				break;
				
			case EEP_IR_LOW_SIZE_LMT_CPS_REF:
				IrLoSizeLmtCpsRef = epr_sm[addr];
				break;
			
			case EEP_IR_LOW_SIZE_LMT:
				IrLoSizeLmt = epr_sm[addr];
				break;
			
			case EEP_IR_1S_AVRG_DV_OVER_LMT:
				Ir1sAvrgDvOverLmt = ((double)epr_sm[addr] * 0.001 );
				break;
				
			case EEP_IR_BIT_THRESHOLD_VOLT:
				IrBitLmt = ((double)epr_sm[addr] * 0.001 );
				break;
				
			case EEP_IR_ROC_LMT:
				IrSizeRocLmt = epr_sm[EEP_IR_ROC_LMT];
				break;
				
			case EEP_IR_REL_RATIO_LMT_CORR_VAL:
				IrRelRatioCorrVal_395 = epr_sm[addr] >> 8 & 255;
				IrRelRatioCorrVal_530 = epr_sm[addr] & 255;
				break;
			
			case EEP_UV_DET_LMT:
				UvDetLmt = ((double)epr_sm[addr] / 1000 );
				break;
				
			case EEP_UV_ZERO_DEV_CNT_LMT:
				UvZrnDvCntLmt = epr_sm[addr];
				break;
				
			case EEP_UV_ZERO_CNT_LMT_CPS_REF:
				UvZrLmtCpsRef = epr_sm[addr];
				break;
				
			case EEP_UV_ZERO_CNT_LMT:
				UvZrCntLmt = epr_sm[addr];
				break;
				
			case EEP_UV_ROC_LMT_CPS_REF:
				UvRocLmtCpsRef = epr_sm[addr];
				break;
				
			case EEP_UV_ROC_LMT:
				UvRocLmt = epr_sm[addr];
				break;
			
			case EEP_UV_BIT_THRESHOLD_CPS:
				UvBitLmt = epr_sm[addr];
				break;
				
			case EEP_BIT_PERIOD:
				BIT_Period = epr_sm[addr];
				break;
				
			case EEP_BIT_RETRY_LMT:
				BIT_Retry_Lmt = epr_sm[addr];
				break;
				
			case EEP_CAL_BUF_UV_CPS:
			case EEP_CAL_VAL_UV_CPS:
				CpsCalSlope = ((double)epr_sm[EEP_CAL_VAL_UV_CPS] / (double)epr_sm[EEP_CAL_BUF_UV_CPS]);
				break;
			
			case EEP_ALM_RLY_OPERATION:
				AlarmRelayMode = epr_sm[addr];
				break;
				
			case EEP_TRB_RLY_OPERATION:
				TroubleRelayMode = epr_sm[addr];
				break;
				
			case EEP_UV_BIT_FINISH_TIME:
				BIT_Event_UvFinishTime = epr_sm[addr];
				break;
				
			case EEP_CAL_BUF_IR430_RESPONSIVITY:
				IR430_Calibration( epr_sm[addr] );
				break;
				
			case EEP_CAL_BUF_IR430_01:
				IrSpanBuf[IR_WL_430][0] = ((double)epr_sm[addr] * 0.001 );
				IR_Slope_Calculator( IR_WL_430, 0 );
				IR_Slope_Calculator( IR_WL_430, 1 );
				break;
				
			case EEP_CAL_BUF_IR430_02:
				IrSpanBuf[IR_WL_430][1] = ((double)epr_sm[addr] * 0.001 );
				IR_Slope_Calculator( IR_WL_430, 1 );
				IR_Slope_Calculator( IR_WL_430, 2 );
				break;
				
			case EEP_CAL_BUF_IR430_03:
				IrSpanBuf[IR_WL_430][2] = ((double)epr_sm[addr] * 0.001 );
				IR_Slope_Calculator( IR_WL_430, 2 );
				IR_Slope_Calculator( IR_WL_430, 3 );
				break;
				
			case EEP_CAL_BUF_IR430_04:
				IrSpanBuf[IR_WL_430][3] = ((double)epr_sm[addr] * 0.001 );
				IR_Slope_Calculator( IR_WL_430, 3 );
				IR_Slope_Calculator( IR_WL_430, 4 );
				break;
				
			case EEP_CAL_BUF_IR430_05:
				IrSpanBuf[IR_WL_430][4] = ((double)epr_sm[addr] * 0.001 );
				IR_Slope_Calculator( IR_WL_430, 4 );
				IR_Slope_Calculator( IR_WL_430, 5 );
				break;
				
			case EEP_CAL_BUF_IR430_06:
				IrSpanBuf[IR_WL_430][5] = ((double)epr_sm[addr] * 0.001 );
				IR_Slope_Calculator( IR_WL_430, 5 );
				IR_Slope_Calculator( IR_WL_430, 6 );
				break;
				
			case EEP_CAL_BUF_IR430_07:
				IrSpanBuf[IR_WL_430][6] = ((double)epr_sm[addr] * 0.001 );
				IR_Slope_Calculator( IR_WL_430, 6 );
				break;
				
			case EEP_CAL_BUF_IR395_01:
				IrSpanBuf[IR_WL_395][0] = ((double)epr_sm[addr] * 0.001 );
				IR_Slope_Calculator( IR_WL_395, 0 );
				IR_Slope_Calculator( IR_WL_395, 1 );
				break;
				
			case EEP_CAL_BUF_IR395_02:
				IrSpanBuf[IR_WL_395][1] = ((double)epr_sm[addr] * 0.001 );
				IR_Slope_Calculator( IR_WL_395, 1 );
				IR_Slope_Calculator( IR_WL_395, 2 );
				break;
				
			case EEP_CAL_BUF_IR395_03:
				IrSpanBuf[IR_WL_395][2] = ((double)epr_sm[addr] * 0.001 );
				IR_Slope_Calculator( IR_WL_395, 2 );
				IR_Slope_Calculator( IR_WL_395, 3 );
				break;
				
			case EEP_CAL_BUF_IR395_04:
				IrSpanBuf[IR_WL_395][3] = ((double)epr_sm[addr] * 0.001 );
				IR_Slope_Calculator( IR_WL_395, 3 );
				IR_Slope_Calculator( IR_WL_395, 4 );
				break;
				
			case EEP_CAL_BUF_IR395_05:
				IrSpanBuf[IR_WL_395][4] = ((double)epr_sm[addr] * 0.001 );
				IR_Slope_Calculator( IR_WL_395, 4 );
				IR_Slope_Calculator( IR_WL_395, 5 );
				break;
				
			case EEP_CAL_BUF_IR395_06:
				IrSpanBuf[IR_WL_395][5] = ((double)epr_sm[addr] * 0.001 );
				IR_Slope_Calculator( IR_WL_395, 5 );
				IR_Slope_Calculator( IR_WL_395, 6 );
				break;
				
			case EEP_CAL_BUF_IR395_07:
				IrSpanBuf[IR_WL_395][6] = ((double)epr_sm[addr] * 0.001 );
				IR_Slope_Calculator( IR_WL_395, 6 );
				break;
				
			case EEP_CAL_BUF_IR530_01:
				IrSpanBuf[IR_WL_530][0] = ((double)epr_sm[addr] * 0.001 );
				IR_Slope_Calculator( IR_WL_530, 0 );
				IR_Slope_Calculator( IR_WL_530, 1 );
				break;
				
			case EEP_CAL_BUF_IR530_02:
				IrSpanBuf[IR_WL_530][1] = ((double)epr_sm[addr] * 0.001 );
				IR_Slope_Calculator( IR_WL_530, 1 );
				IR_Slope_Calculator( IR_WL_530, 2 );
				break;
				
			case EEP_CAL_BUF_IR530_03:
				IrSpanBuf[IR_WL_530][2] = ((double)epr_sm[addr] * 0.001 );
				IR_Slope_Calculator( IR_WL_530, 2 );
				IR_Slope_Calculator( IR_WL_530, 3 );
				break;
				
			case EEP_CAL_BUF_IR530_04:
				IrSpanBuf[IR_WL_530][3] = ((double)epr_sm[addr] * 0.001 );
				IR_Slope_Calculator( IR_WL_530, 3 );
				IR_Slope_Calculator( IR_WL_530, 4 );
				break;
				
			case EEP_CAL_BUF_IR530_05:
				IrSpanBuf[IR_WL_530][4] = ((double)epr_sm[addr] * 0.001 );
				IR_Slope_Calculator( IR_WL_530, 4 );
				IR_Slope_Calculator( IR_WL_530, 5 );
				break;
				
			case EEP_CAL_BUF_IR530_06:
				IrSpanBuf[IR_WL_530][5] = ((double)epr_sm[addr] * 0.001 );
				IR_Slope_Calculator( IR_WL_530, 5 );
				IR_Slope_Calculator( IR_WL_530, 6 );
				break;
				
			case EEP_CAL_BUF_IR530_07:
				IrSpanBuf[IR_WL_530][6] = ((double)epr_sm[addr] * 0.001 );
				IR_Slope_Calculator( IR_WL_530, 6 );
				break;
				
			case EEP_CAL_VAL_IR430_01:
				IrSpanVal[IR_WL_430][0] = epr_sm[addr];
				IR_Slope_Calculator( IR_WL_430, 0 );
				IR_Slope_Calculator( IR_WL_430, 1 );
				break;
				
			case EEP_CAL_VAL_IR430_02:
				IrSpanVal[IR_WL_430][1] = epr_sm[addr];
				IR_Slope_Calculator( IR_WL_430, 1 );
				IR_Slope_Calculator( IR_WL_430, 2 );
				break;
				
			case EEP_CAL_VAL_IR430_03:
				IrSpanVal[IR_WL_430][2] = epr_sm[addr];
				IR_Slope_Calculator( IR_WL_430, 2 );
				IR_Slope_Calculator( IR_WL_430, 3 );
				break;
				
			case EEP_CAL_VAL_IR430_04:
				IrSpanVal[IR_WL_430][3] = epr_sm[addr];
				IR_Slope_Calculator( IR_WL_430, 3 );
				IR_Slope_Calculator( IR_WL_430, 4 );
				break;
				
			case EEP_CAL_VAL_IR430_05:
				IrSpanVal[IR_WL_430][4] = epr_sm[addr];
				IR_Slope_Calculator( IR_WL_430, 4 );
				IR_Slope_Calculator( IR_WL_430, 5 );
				break;
				
			case EEP_CAL_VAL_IR430_06:
				IrSpanVal[IR_WL_430][5] = epr_sm[addr];
				IR_Slope_Calculator( IR_WL_430, 5 );
				IR_Slope_Calculator( IR_WL_430, 6 );
				break;
				
			case EEP_CAL_VAL_IR430_07:
				IrSpanVal[IR_WL_430][6] = epr_sm[addr];
				IR_Slope_Calculator( IR_WL_430, 6 );
				break;
				
			case EEP_CAL_VAL_IR395_01:
				IrSpanVal[IR_WL_395][0] = epr_sm[addr];
				IR_Slope_Calculator( IR_WL_395, 0 );
				IR_Slope_Calculator( IR_WL_395, 1 );
				break;
				
			case EEP_CAL_VAL_IR395_02:
				IrSpanVal[IR_WL_395][1] = epr_sm[addr];
				IR_Slope_Calculator( IR_WL_395, 1 );
				IR_Slope_Calculator( IR_WL_395, 2 );
				break;
				
			case EEP_CAL_VAL_IR395_03:
				IrSpanVal[IR_WL_395][2] = epr_sm[addr];
				IR_Slope_Calculator( IR_WL_395, 2 );
				IR_Slope_Calculator( IR_WL_395, 3 );
				break;
				
			case EEP_CAL_VAL_IR395_04:
				IrSpanVal[IR_WL_395][3] = epr_sm[addr];
				IR_Slope_Calculator( IR_WL_395, 3 );
				IR_Slope_Calculator( IR_WL_395, 4 );
				break;
				
			case EEP_CAL_VAL_IR395_05:
				IrSpanVal[IR_WL_395][4] = epr_sm[addr];
				IR_Slope_Calculator( IR_WL_395, 4 );
				IR_Slope_Calculator( IR_WL_395, 5 );
				break;
				
			case EEP_CAL_VAL_IR395_06:
				IrSpanVal[IR_WL_395][5] = epr_sm[addr];
				IR_Slope_Calculator( IR_WL_395, 5 );
				IR_Slope_Calculator( IR_WL_395, 6 );
				break;
				
			case EEP_CAL_VAL_IR395_07:
				IrSpanVal[IR_WL_395][6] = epr_sm[addr];
				IR_Slope_Calculator( IR_WL_395, 6 );
				break;
				
			case EEP_CAL_VAL_IR530_01:
				IrSpanVal[IR_WL_530][0] = epr_sm[addr];
				IR_Slope_Calculator( IR_WL_530, 0 );
				IR_Slope_Calculator( IR_WL_530, 1 );
				break;
				
			case EEP_CAL_VAL_IR530_02:
				IrSpanVal[IR_WL_530][1] = epr_sm[addr];
				IR_Slope_Calculator( IR_WL_530, 1 );
				IR_Slope_Calculator( IR_WL_530, 2 );
				break;
				
			case EEP_CAL_VAL_IR530_03:
				IrSpanVal[IR_WL_530][2] = epr_sm[addr];
				IR_Slope_Calculator( IR_WL_530, 2 );
				IR_Slope_Calculator( IR_WL_530, 3 );
				break;
				
			case EEP_CAL_VAL_IR530_04:
				IrSpanVal[IR_WL_530][3] = epr_sm[addr];
				IR_Slope_Calculator( IR_WL_530, 3 );
				IR_Slope_Calculator( IR_WL_530, 4 );
				break;
				
			case EEP_CAL_VAL_IR530_05:
				IrSpanVal[IR_WL_530][4] = epr_sm[addr];
				IR_Slope_Calculator( IR_WL_530, 4 );
				IR_Slope_Calculator( IR_WL_530, 5 );
				break;
				
			case EEP_CAL_VAL_IR530_06:
				IrSpanVal[IR_WL_530][5] = epr_sm[addr];
				IR_Slope_Calculator( IR_WL_530, 5 );
				IR_Slope_Calculator( IR_WL_530, 6 );
				break;
				
			case EEP_CAL_VAL_IR530_07:
				IrSpanVal[IR_WL_530][6] = epr_sm[addr];
				IR_Slope_Calculator( IR_WL_530, 6 );
				break;
				
			case EEP_UV_ZERO_CNT_DEV_LMT:
				UvZrCntDvLmt = epr_sm[addr];
				break;
				
			case EEP_TRIPMODE_IR_TIME_DV_LMT:
				TripModeIrTimeDvLmt = epr_sm[addr];
				break;
				
			case EEP_EVT_BIT_RETRY_CNT:
				BIT_Retry_Cnt = epr_sm[addr];
				break;
				
			case EEP_EVT_BIT_FAULT_CNT:
				BIT_Event_Cnt = epr_sm[addr];
				break;
				
			case EEP_EVT_PWR_FAULT_CNT:
				PWR_Event_Cnt = epr_sm[addr];
				break;
				
			case EEP_EVT_MIN_TEMP:
				MinTemp = ((double)epr_sm[addr] / 10);
				break;
				
			case EEP_EVT_MAX_TEMP:
				MaxTemp = ((double)epr_sm[addr] / 10);
				break;
				
			case EEP_EVT_CPS_RAW_MAX:
				CpsRawMax = epr_sm[addr];
				break;
				
			case EEP_EVT_CPS_ITG_MAX:
				CpsItgMax = ((double)epr_sm[addr] / 10);
				break;
		}
	}
}

/////////////////////////////////////////////////////////////////////////////////////////////////////////////////////////////////////

U16 EEP_Rd( U16 addr )
{
	U16		wadd, data;
	
	wadd = addr*2;
	
	data = eeprom_read_word( (U16*)wadd );
	
	return data;
}

/////////////////////////////////////////////////////////////////////////////////////////////////////////////////////////////////////

void EEP_CRC_Wr( U8 Eep_Block )
{
	U16		wCRC;
	U8		*pdat;
	
#if 0
	U16		i;
	
	for( i=EEP_PREFIX_1; i<EEP_MAX; i++ ){
		epr_sm[i] = EEP_Rd(i);
	}
#endif
	switch(Eep_Block)
	{
		case EEP_BLOCK_1:
			pdat = (U8*)(&epr_sm[EEP_PREFIX_1]);
			wCRC = CRC16( pdat, (EEP_EVT_BIT_IR430_1S_PTOP_MIN-EEP_PREFIX_1)*2 );
			epr_sm[EEP_CHECKSUM_1] = wCRC;
			EEP_Wr( EEP_CHECKSUM_1, epr_sm[EEP_CHECKSUM_1] );
			break;
		case EEP_BLOCK_2:
			pdat = (U8*)(&epr_sm[EEP_FLAME_TYPE]);
			wCRC = CRC16( pdat, (EEP_CHECKSUM_2-EEP_FLAME_TYPE)*2 );
			epr_sm[EEP_CHECKSUM_2] = wCRC;
			EEP_Wr( EEP_CHECKSUM_2, epr_sm[EEP_CHECKSUM_2] );
			break;
		case EEP_RATIO_395:
		case EEP_RATIO_530:
			wCRC = Ratio_CRC16();
			EEP_Wr( EEP_RATIO_CHECKSUM, wCRC );
			break;
		default:
			EepErrorFlag = 1;
			break;
	}
/*
	pdat = (U8*)(&epr_sm[EEP_PREFIX_1]);
	wCRC = CRC16( pdat, (EEP_EVT_BIT_IR430_1S_PTOP_MIN-EEP_PREFIX_1)*2 );
	epr_sm[EEP_CHECKSUM_1] = wCRC;
	EEP_Wr( EEP_CHECKSUM_1, epr_sm[EEP_CHECKSUM_1] );*/
}

/////////////////////////////////////////////////////////////////////////////////////////////////////////////////////////////////////

U8 EEP_Block_Check( U16 addr )
{
	U8	Block = 0;

	if( ( EEP_PREFIX_1 < addr ) && ( addr < EEP_FLAME_TYPE ) )
	{
		Block = EEP_BLOCK_1;
	}
	else if( ( EEP_FLAME_TYPE <= addr ) && ( addr < EEP_RATIO_RESERVED ) )
	{
		Block = EEP_BLOCK_2;
	}
	else if( ( EEP_RATIO_RESERVED <= addr ) && ( addr < TRIPLE_IR_REL_RATIO_530_SIZE_1 ) )
	{
		Block = EEP_RATIO_395;
	}
	else if( ( TRIPLE_IR_REL_RATIO_530_SIZE_1 <= addr ) && ( addr < TRIPLE_IR_REL_RATIO_MAX ) )
	{
		Block = EEP_RATIO_530;
	}
	else
	{
		EepErrorFlag = 1;
	}
	
	//printf("\r\n add = %d, Block = %d, Err-%d", addr, Block, EepErrorFlag);
	
	return Block;
}


/////////////////////////////////////////////////////////////////////////////////////////////////////////////////////////////////////

U8 EEP_CRC_Check( U8 Eep_Block )
{
	U16			wCRC;
	U16			i;
	U16			epr[EEP_MAX];
	U16			Read_CRC = 0;
	U8			*pdat;
	U8			ret = 0;
	
	for( i=EEP_CHECKSUM_1; i<EEP_MAX; i++ ){
		epr[i] = EEP_Rd(i);	
	}

	switch(Eep_Block)
	{
		case EEP_BLOCK_1:
			pdat = (U8*)(&epr[EEP_PREFIX_1]);
			wCRC = CRC16( pdat, (EEP_EVT_BIT_IR430_1S_PTOP_MIN - EEP_PREFIX_1)*2 );	
			Read_CRC = epr[EEP_CHECKSUM_1];
			break;
		case EEP_BLOCK_2:
			pdat = (U8*)(&epr[EEP_FLAME_TYPE]);
			wCRC = CRC16( pdat, (EEP_CHECKSUM_2 - EEP_FLAME_TYPE)*2 );
			Read_CRC = epr[EEP_CHECKSUM_2];
			break;
		case EEP_RATIO_395:
		case EEP_RATIO_530:
			wCRC = Ratio_CRC16();
			Read_CRC = EEP_Rd(EEP_RATIO_CHECKSUM);
			break;
		default: 
			ret = 1; 
			break;
	}
	
	if( Read_CRC != wCRC ){
		ret = 1;
	}
	
	//printf("\r\n EEP-%d CRC_C = %04x, CRC_R = %04x", Eep_Block, wCRC, Read_CRC);
/*	
	for( i=EEP_CHECKSUM_1; i<EEP_EVT_BIT_IR430_1S_PTOP_MIN; i++ ){
		epr[i] = EEP_Rd(i);
	}
	
	pdat = (U8*)(&epr[EEP_PREFIX_1]);
	wCRC = CRC16( pdat, (EEP_EVT_BIT_IR430_1S_PTOP_MIN-EEP_PREFIX_1)*2 );
	
	if( epr[EEP_CHECKSUM_1] != wCRC ){
		ret = 1;
	}
*/
	return ret;
}

/////////////////////////////////////////////////////////////////////////////////////////////////////////////////////////////////////

void EEP_Load( void )
{
	U16		i;

	EepErrorFlag = 0;
	
	if( EEP_Rd( EEP_PREFIX_1 ) != EEPROM_MARKING_1 ) {
		EEP_SysFormat(EEP_BLOCK_1);
#if 0
		printf( "\n\n EEPROM FORMAT!\n" );
		eeprom_update_word( (U16*)0, pgm_read_word( &EEP_SYS_DEFAULT[0] ));
		for( i=EEP_MAX; i<0x800; i++ ){
			eeprom_update_word( (U16*)(i*2), i );
			WT_Clr();
		}
#endif
	}
	else {
		for(i=0; i<EEP_FLAME_TYPE; i++){
			epr_sm[i] = EEP_Rd(i);
			Delay_ms( 1 );
		}
	}
	
	if( EEP_CRC_Check(EEP_BLOCK_1) ){
		EepErrorFlag = 1;
	}
		
	if( EEP_Rd( EEP_PREFIX_2 ) != EEPROM_MARKING_2 ) {
		EEP_SysFormat(EEP_BLOCK_2);
	}
	else {
		for(i=EEP_FLAME_TYPE; i<EEP_MAX; i++){
			epr_sm[i] = EEP_Rd(i);
			Delay_ms( 1 );
		}
	}
	
	if( EEP_CRC_Check(EEP_BLOCK_2) ){
		EepErrorFlag = 1;
	}
	
	Delay_ms( 10 );
	
	if( EEP_Rd( EEP_RATIO_PREFIX ) != EEPROM_RATIO_MARKING ) {
		EEP_SysFormat(EEP_RATIO_395);
		Delay_ms( 10 );
		EEP_SysFormat(EEP_RATIO_530);
	}
	
	if( EEP_CRC_Check(EEP_RATIO_395) ){
		EepErrorFlag = 1;
	}

	Delay_ms( 500 );
	
#if 0
	printf( "\n\n EEPROM CHECK!\n" );
	for( i=0; i<0x800; i++ ){
		if( i<EEP_MAX ){
			if( eeprom_read_word( (U16*)(i*2) ) != pgm_read_word( &EEP_SYS_DEFAULT[i] )){
				printf( " [%04X]: READ(%04X), WRITE(%04X)\n", i, eeprom_read_word( (U16*)(i*2) ), pgm_read_word( &EEP_SYS_DEFAULT[i] ));
			}
		}
		else {
			if( eeprom_read_word( (U16*)(i*2) ) != i ){
				printf( " [%04X]: READ(%04X), WRITE(%04X)\n", i, eeprom_read_word( (U16*)(i*2) ), i );
			}
		}
		WT_Clr();
	}
	printf( "\n\n COMPLETE!\n" );
#endif
}

/////////////////////////////////////////////////////////////////////////////////////////////////////////////////////////////////////

void EEP_SysFormat( U8 Eep_Block )
{
	U16		i;
	
	P24 = 24.f;
	
	switch(Eep_Block)
	{
		case EEP_BLOCK_1:
			for( i=0; i<EEP_FLAME_TYPE; i++ ){
				if( ( i == EEP_SERIAL_NO_L ) || ( i == EEP_SERIAL_NO_H ) ||
				( i == EEP_UV_DET_LMT ) || ( i == EEP_CAL_BUF_UV_CPS ) ||
				(( i >= EEP_CAL_BUF_IR430_RESPONSIVITY ) && ( i <= EEP_CAL_BUF_IR530_07 )) )
				//if( ( i == EEP_SERIAL_NO_L ) || ( i == EEP_SERIAL_NO_H ) )
				{
					epr_sm[i] = EEP_Rd(i);
					Delay_ms( 1 );
				}
				else {
					epr_sm[i] = pgm_read_word( &EEP_SYS_DEFAULT[i] );
					EEP_Wr( i, epr_sm[i] );
				}
			}
			break; 	
		case EEP_BLOCK_2:
			for( i=EEP_FLAME_TYPE; i<=EEP_MAX; i++ ){
				if( i == EEP_FLAME_TYPE)
				{
					epr_sm[i] = EEP_Rd(i);
					Delay_ms( 1 );
				}
				else {
					epr_sm[i] = pgm_read_word( &EEP_SYS_DEFAULT[i] );
					EEP_Wr( i, epr_sm[i] );
				}
			}
			break;
		case EEP_RATIO_395:
			for (i = EEP_RATIO_RESERVED; i <=TRIPLE_IR_REL_RATIO_395_SIZE_999; i++)
			{
				EEP_Wr(i, pgm_read_word( &EEP_SYS_DEFAULT[i] ));
			}
			break;
			
		case EEP_RATIO_530:
			for (i = TRIPLE_IR_REL_RATIO_530_SIZE_1; i <=TRIPLE_IR_REL_RATIO_MAX; i++)
			{
				EEP_Wr(i, pgm_read_word( &EEP_SYS_DEFAULT[i] ));
			}
			break;
		default: 
			EepErrorFlag = 1;
			break;
	}
	
	EEP_CRC_Wr( Eep_Block );
}
